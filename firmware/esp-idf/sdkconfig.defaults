## firmware/esp-idf/sdkconfig.defaults
```kconfig
CONFIG_ESP_WIFI_SSID="NETRA32-AP"
CONFIG_ESP_WIFI_PASSWORD=""
CONFIG_ESP_WIFI_SCAN_AUTH_MODE_THRESHOLD=4
CONFIG_ESP_WIFI_STATIC_RX_BUFFER_NUM=10
CONFIG_ESP_WIFI_DYNAMIC_RX_BUFFER_NUM=32
CONFIG_ESP_WIFI_DYNAMIC_TX_BUFFER_NUM=32
CONFIG_ESP_WIFI_AMPDU_TX_ENABLED=y
CONFIG_ESP_WIFI_AMPDU_RX_ENABLED=y
CONFIG_ESP_WIFI_RX_BA_WIN=6
CONFIG_LWIP_MAX_SOCKETS=10
CONFIG_USE_ONLY_LWIP_SELECT=y
```
